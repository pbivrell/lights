#include <WiFi.h>
#include <WebServer.h>
#include <Adafruit_NeoPixel.h>
#include <EEPROM.h>
#include <HTTPClient.h>
#include <DNSServer.h>
#include <Update.h>

#define EEPROM_DATA_SIZE 32
#define EEPROM_TOTAL_SIZE (2 * EEPROM_DATA_SIZE) + 2
#define LED_DEFAULT 1000

const char* ssidAP     = "polites-setup";
const char* passwordAP = "";
IPAddress apIP(8, 8, 4, 4);
IPAddress subnet(255, 255, 255, 0);
bool dnsEnabled = false;
DNSServer dnsServer;
bool hasCredentials;

#define LED_PIN     15
#define TOUCH_PIN   4 

uint8_t LightCount = 100;

Adafruit_NeoPixel strip(LED_DEFAULT, LED_PIN, NEO_GRB + NEO_KHZ800);
WebServer server(80);

/*
 * Credentials storage
 */

// readCreds retrieves credentials from EEPROM, returning a boolean indicating if the credentials exist.
bool readCreds(char ssid[EEPROM_DATA_SIZE], char password[EEPROM_DATA_SIZE]) {

  char ok[2];
  ok[0] = char(EEPROM.read(0 + (EEPROM_DATA_SIZE * 2)));
  ok[1] = char(EEPROM.read(1 + (EEPROM_DATA_SIZE * 2)));
  
  if (ok[0] != 'O' || ok[1] != 'K') {
    return false;
  }
  
  for (int i = 0; i < EEPROM_DATA_SIZE; ++i){
    ssid[i] = char(EEPROM.read(i));
    if (ssid[i] == '\0') {
      break;
    }
  }

  for (int i = 0; i < EEPROM_DATA_SIZE; ++i){
    password[i] = char(EEPROM.read(i + EEPROM_DATA_SIZE));
    if (password[i] == '\0') {
      break;
    }
  }

  return true;
}

bool writeCreds(String ssidS, String passwordS) {

  char ssid[EEPROM_DATA_SIZE];
  char password[EEPROM_DATA_SIZE];

  if (ssidS.length() > EEPROM_DATA_SIZE || passwordS.length() > EEPROM_DATA_SIZE) {
    return false;
  }

  ssidS.toCharArray(ssid, 32);
  passwordS.toCharArray(password, 32);
  
  for (int i = 0; i < ssidS.length(); ++i){
    EEPROM.write(i, ssid[i]);
  }
  EEPROM.write(ssidS.length(), '\0');
  
  for (int i = 0; i < passwordS.length() ; ++i){
    EEPROM.write(i + EEPROM_DATA_SIZE, password[i]);
  }
  EEPROM.write(passwordS.length() + EEPROM_DATA_SIZE, '\0');


  char ok[2];
  EEPROM.write(0 + (EEPROM_DATA_SIZE * 2), 'O');
  EEPROM.write(1 + (EEPROM_DATA_SIZE * 2), 'K');

  EEPROM.commit();
  return true;
}

/*
 * Web server.
 */

void startServer() {
  server.stop();
  server.on("/off", handleOff);
  server.on("/all", handleAll);
  server.on("/color", handleColor);
  server.onNotFound ( handleNotFound );
  server.enableCORS();
  
  server.begin();
}

bool startWiFi(const char * ssid, const char * password, int timeout) {
  Serial.println("Connecting to WIFI");
  
  WiFi.begin(ssid, password);
  Serial.println("");

  int n = 0;
  // Wait for connection
  while (WiFi.status() != WL_CONNECTED && n++ < timeout) {
    delay(500);
    Serial.print(".");
  }
  Serial.println("");
  return WiFi.status() == WL_CONNECTED;
}

void setPixel(uint8_t r, uint8_t g, uint8_t b, uint8_t index) {
  strip.setPixelColor(index, strip.Color(g, r, b)); 
}

void handleOff() {
  Serial.println("Handler: /toggle");
  strip.clear();
  strip.show();
  server.send(200, "text/html", "OK"); 
}

void handleColor() {
  Serial.println("handling: /color");
  int r = server.arg("r").toInt();
  int g = server.arg("g").toInt();
  int b = server.arg("b").toInt();
  int i = server.arg("i").toInt();
  setPixel(r,g,b,i);
  strip.show();
  server.send(200, "text/html", "OK"); 
}

void handleAll() {
  Serial.println("handling: /color");
  int r = server.arg("r").toInt();
  int g = server.arg("g").toInt();
  int b = server.arg("b").toInt();
  for (int i = 0; i < LightCount; i++) {
    setPixel(r,g,b, i);
  }
  strip.show();
  server.send(200, "text/html", "OK"); 
}


/*
 * AP MODE
 */


// AP Handlers.

// handleIndex is a response handler that returns the page generated by the WifiSetup function.
void handleIndex() {
  Serial.println("Handler: /");
  if (captivePortal()) { // If caprive portal redirect instead of displaying the error page.
    return;
  }
  Serial.println("wot");
  //String html = WifiSetup();
  server.send(200, "text/html", WifiSetup()); 
}

// handleLogin is a response handler that reads the query paramters ssid and password then attempts to
// join that network. It will return 200 OK if connected and 500 Not Connected otherwise.
void handleLogin() {
  Serial.println("Handler: /login");

  String ssid = server.arg("ssid");
  String password = server.arg("password");
  Serial.println(ssid);
  Serial.println(password);

  if(startWiFi(ssid.c_str(), password.c_str(), 30)) {
    Serial.println("connected");
    if (writeCreds(ssid, password)) {
      server.send(200, "text/html", Connected());
      delay(250);
      ESP.restart();
      return;
    }
  }
  
  server.send(500, "text/html", Failed());
  delay(50);
  redirect();
}

String Failed() {
  return
  "<html>"
"  <head>"
"    <script>"
"setTimeout(function() {"
"  window.location.href = '/';"
"}, 5 * 1000);"
"    </script>"
"    <meta content=\"width=device-width, initial-scale=1\" name=\"viewport\" />"
""
"    <style>"
"      .text{"
"        font-size: 2em;"
"      }"
"      @media only screen and (max-width: 600px) {"
"        #container{"
"          margin: 0;"
"          width: 98%;"
"          font-size: 1.4em;"
"        }"
"      }"
"    </style>"
"  </head>"
"  <body>"
"    <p class=\"text\">Could not connect!</p>"
"  </body>"
"</html>";
}

String Connected() {
  return
  "<html>"
"  <head>"
"    <meta content=\"width=device-width, initial-scale=1\" name=\"viewport\" />"
""
"    <style>"
"      .text{"
"        font-size: 2em;"
"      }"
"      @media only screen and (max-width: 600px) {"
"        #container{"
"          margin: 0;"
"          width: 98%;"
"          font-size: 1.4em;"
"        }"
"      }"
"    </style>"
"  </head>"
"  <body>"
"    <p class=\"text\">Your light is now connected!</p>"
"  </body>"
"</html>";
}

void redirect() {
    server.sendHeader("Location", String("http://") + toStringIp(server.client().localIP()), true);
    server.send ( 302, "text/plain", ""); // Empty content inhibits Content-length header so we have to close the socket ourselves.
    server.client().stop(); 
}

boolean captivePortal() {
  Serial.println("Captive Portal");
  if (!isIp(server.hostHeader())) {
    Serial.print("Request redirected to captive portal");
    server.sendHeader("Location", String("http://") + toStringIp(server.client().localIP()), true);
    server.send ( 302, "text/plain", ""); // Empty content inhibits Content-length header so we have to close the socket ourselves.
    server.client().stop(); // Stop is needed because we sent no content length
    return true;
  }
  return false;
}

void handleNotFound() {
  if (captivePortal()) { // If caprive portal redirect instead of displaying the error page.
    return;
  }
  String message = "File Not Found\n\n";
  message += "URI: ";
  message += server.uri();
  message += "\nMethod: ";
  message += ( server.method() == HTTP_GET ) ? "GET" : "POST";
  message += "\nArguments: ";
  message += server.args();
  message += "\n";

  for ( uint8_t i = 0; i < server.args(); i++ ) {
    message += " " + server.argName ( i ) + ": " + server.arg ( i ) + "\n";
  }
  server.sendHeader("Cache-Control", "no-cache, no-store, must-revalidate");
  server.sendHeader("Pragma", "no-cache");
  server.sendHeader("Expires", "-1");
  server.send ( 404, "text/plain", message );
}

String toStringIp(IPAddress ip) {
  String res = "";
  for (int i = 0; i < 3; i++) {
    res += String((ip >> (8 * i)) & 0xFF) + ".";
  }
  res += String(((ip >> 8 * 3)) & 0xFF);
  return res;
}

boolean isIp(String str) {
  Serial.println(str);
  for (int i = 0; i < str.length(); i++) {
    int c = str.charAt(i);
    if (c != '.' && (c < '0' || c > '9')) {
      return false;
    }
  }
  return true;
}

String WifiSetup() {

  WiFi.disconnect();
  int n = WiFi.scanNetworks(); 
  String ssids[n];
  for (int i = 0; i < n; ++i) {      
    ssids[i] = WiFi.SSID(i) ;
    Serial.println(ssids[i]);
    delay(10);
  }

  String options = "";
  for (int i = 0; i < n; ++i) {
    options += "<option value=\"" +  ssids[i] + "\">" + ssids[i] + "</option>\n";
  }
  Serial.println("Produced HTML");
  
  return 
"<html>"
"  <head>"
"    <meta content=\"width=device-width, initial-scale=1\" name=\"viewport\" />"
""
"    <script>"
"      function toggleLoading() {"
"        var div = document.getElementById('loading');"
"        div.style.display = div.style.display == \"none\" ? \"block\" :\"none\";"
"      }"
"    </script>"
"    <style>"
"      .text{"
"        font-size: 2em;"
"      }"
""
"      input[type=password], select {"
"        width: 100%;"
"        padding: 12px;"
"        border: 1px solid #ccc;"
"        border-radius: 4px;"
"        resize: vertical;"
"        font-size: 25px;"
"      }"
""      
"      #loading {"
"        display: inline-block;"
"        width: 50px;"
"        height: 50px;"
"        border: 3px solid rgba(255,255,255,.3);"
"        border-radius: 50%;"
"        border-top-color: #fff;"
"        animation: spin 1s ease-in-out infinite;"
"        -webkit-animation: spin 1s ease-in-out infinite;"
"      }"
""
"      @keyframes spin {"
"        to { -webkit-transform: rotate(360deg); }"
"      }"
"      @-webkit-keyframes spin {"
"        to { -webkit-transform: rotate(360deg); }"
"      }"
""
"      #container{"
"        background: #f2f2f2;"
"        padding-left: 1%;"
"        padding-right: 1%;"
"        font-size: 25px;"
"        margin: 0 auto;"
"        width: 75%;"
"      }"
""
"      label{"
"        margin-bottom: 10px;"
"        display: block;"
"      }"
""
"      .subtext{"
"        color: darkgrey;"
"      }"
""
"      input[type=submit] {"
"        float: right;"
"        background-color: green;"
"        color: white;"
"        border: none;"
"        border-radius: 4px;"
"        margin-top: 10px;"
"        padding: 12px 20px;"
"        font-size: 25px;"
"      }"
""
"      @media only screen and (max-width: 600px) {"
"        #container{"
"          margin: 0;"
"          width: 98%;"
"          font-size: 1.4em;"
"        }"
"      }"
"    </style>"
"  </head>"
"  <body>"
"    <div id=\"loading\"></div>"
"    <p class=\"text\">Welcome to polites!</p>"
"    <div id=\"container\">"
"      <p class=\"subtext\">Configure the lights by connecting to your WiFi</p>"
"      <form action=\"/login\">"
"        <label for=\"wifi\">WiFi</label>"
"        <select name=\"ssid\">" + options +
"        </select><br><br>"
"        <label for=\"password\">Password</label>"
"        <input type=\"password\" id=\"password\" name=\"password\"><br><br>"
"        <input type=\"submit\" value=\"Submit\" onclick=\"toggleLoading()\">"
"      </form>"
"    </div>"
"  </body>"
"</html>";
}

// startAP creates an AP with the provided ssid and password at the globally configured network.
// startAP then also configures and starts a webserver with routes for connecting to a local network.
void startAP(const char *ssid, const char *password) {

  WiFi.softAPConfig(apIP, apIP, subnet);
  WiFi.softAP(ssid, password);

  IPAddress IP = WiFi.softAPIP();
  Serial.print("AP IP address: ");
  Serial.println(IP);

  //server.enableCORS();
  server.on("/", handleIndex);
  server.on("/login", handleLogin);
  server.onNotFound ( handleNotFound );

  server.begin();
}

void clearWiFi() {
  writeCreds("bad", "pass");
}

void setup() {
  Serial.begin(115200);
  strip.begin(); 
  delay(500);
         
  char ssid[32];
  char password[32]; 

  EEPROM.begin(EEPROM_TOTAL_SIZE);   
  delay(5000);
  Serial.println("Hey Paul");
  hasCredentials = readCreds(ssid, password);
  Serial.println(ssid);
  Serial.println(password);
  if (hasCredentials) {
    if (startWiFi(ssid, password, 30)) {
      startServer();
      Serial.println(WiFi.localIP());
      return;
    }
  }
  
  WiFi.mode(WIFI_MODE_APSTA);  
  startAP(ssidAP, passwordAP);
  dnsServer.start(53, "*", WiFi.softAPIP());
  dnsEnabled = true;

}

void loop() {
  if (dnsEnabled) {
    dnsServer.processNextRequest();
  }
  server.handleClient();
  int touch = touchRead(TOUCH_PIN);
  if (hasCredentials && touch < 20) {
    clearWiFi();
    ESP.restart();
  }

}
